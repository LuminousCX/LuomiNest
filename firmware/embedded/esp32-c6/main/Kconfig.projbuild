## firmware/embedded/esp32-c6/main/Kconfig.projbuild
```kconfig
config C6_WIFI_SSID
    string "WiFi SSID"
    default "YourWiFiSSID"

config C6_WIFI_PASSWORD
    string "WiFi Password"
    default "YourWiFiPassword"

config C6_MQTT_BROKER
    string "MQTT Broker URI"
    default "mqtt://192.168.1.222:1883"
```

## firmware/embedded/esp32-c6/sdkconfig.defaults
```kconfig
CONFIG_IDF_TARGET="esp32c6"

CONFIG_SPIRAM=y
CONFIG_SPIRAM_SPEED_120M=y

CONFIG_ESP_MAIN_TASK_STACK_SIZE=8192
CONFIG_FREERTOS_HZ=1000

CONFIG_COMPILER_OPTIMIZATION_PERF=y

CONFIG_MQTT_PROTOCOL_311=y

CONFIG_LWIP_SNTP_MAX_SERVERS=2
```

## firmware/esp32-p4/main/Kconfig.projbuild
```kconfig
menu "LuomiNest Configuration"

    config LN_WIFI_SSID
        string "WiFi SSID"
        default "Xiaomi_65DF"
        help
            Default WiFi network name (used when no NVS config saved).

    config LN_WIFI_PASSWORD
        string "WiFi Password"
        default "18033810300xyr"
        help
            Default WiFi network password (used when no NVS config saved).

    config LN_AP_PASSWORD
        string "AP mode password"
        default "18033810300xyr"
        help
            Password for the configuration AP hotspot.

    config LN_WIFI_RECONNECT_MAX_MS
        int "WiFi max reconnect backoff (ms)"
        default 30000
        range 5000 300000

    config LN_MQTT_BROKER
        string "MQTT Broker URI"
        default "mqtt://192.168.1.222:1883"
        help
            Default MQTT broker address (used when no NVS config saved).

    config LN_MQTT_CLIENT_ID
        string "MQTT Client ID"
        default "luominest_p4_01"
        help
            Default MQTT client identifier.

    config LN_MQTT_RECONNECT_MAX_MS
        int "MQTT max reconnect backoff (ms)"
        default 60000
        range 5000 300000

    config LN_FRAME_DEDUP
        bool "Enable frame deduplication"
        default y

    config LN_STATUS_INTERVAL_SEC
        int "Status report interval (seconds)"
        default 10
        range 5 120

    choice LN_ETH_PHY_TYPE
        prompt "Ethernet PHY chip"
        default LN_ETH_PHY_IP101
        help
            Select the PHY chip on your board.

    config LN_ETH_PHY_IP101
        bool "IP101"
    config LN_ETH_PHY_LAN8720
        bool "LAN8720/LAN87xx"
    config LN_ETH_PHY_RTL8201
        bool "RTL8201"
    config LN_ETH_PHY_DP83848
        bool "DP83848"
    config LN_ETH_PHY_KSZ80XX
        bool "KSZ80XX"
    config LN_ETH_PHY_GENERIC
        bool "Generic IEEE 802.3"
    endchoice

    config LN_ETH_PHY_ADDR
        int "PHY address"
        default 1
        range 0 31
        help
            PHY address on the MDIO bus. Use -1 for auto-detect (not all PHYs support this).

    config LN_ETH_CONNECT_TIMEOUT_MS
        int "Ethernet connect timeout (ms)"
        default 8000
        range 2000 30000
        help
            How long to wait for Ethernet to get an IP before falling back to WiFi.

endmenu
```

## firmware/esp32-p4/sdkconfig.defaults
```kconfig
CONFIG_IDF_TARGET="esp32p4"

CONFIG_ESPTOOLPY_FLASHMODE_QIO=y
CONFIG_ESPTOOLPY_FLASHSIZE_16MB=y

CONFIG_SPIRAM=y
CONFIG_SPIRAM_SPEED_200M=y
CONFIG_SPIRAM_XIP_FROM_PSRAM=y
CONFIG_CACHE_L2_CACHE_256KB=y
CONFIG_CACHE_L2_CACHE_LINE_128B=y
CONFIG_SPIRAM_TRY_ALLOCATE_WIFI_LWIP=y

CONFIG_ESP_MAIN_TASK_STACK_SIZE=10240
CONFIG_FREERTOS_HZ=1000

CONFIG_ESP_TASK_WDT_TIMEOUT_S=10

CONFIG_ESP_LDO_CHAN4_VOLTAGE_MV=3300

CONFIG_SPI_FLASH_SUPPORT_BOYA_CHIP=y

CONFIG_COMPILER_OPTIMIZATION_PERF=y
CONFIG_IDF_EXPERIMENTAL_FEATURES=y

CONFIG_ESP32P4_REV_MIN_FULL=100

CONFIG_SLAVE_IDF_TARGET_ESP32C6=y

CONFIG_ESP_HOSTED_ENABLED=y
CONFIG_ESP_HOSTED_SDIO_HOST_INTERFACE=y
CONFIG_ESP_HOSTED_IDF_SLAVE_TARGET="esp32c6"
CONFIG_ESP_HOSTED_SDIO_SLOT_1=y
CONFIG_ESP_HOSTED_SDIO_4_BIT_BUS=y
CONFIG_ESP_HOSTED_SDIO_BUS_WIDTH=4
CONFIG_ESP_HOSTED_SDIO_CLOCK_FREQ_KHZ=40000
CONFIG_ESP_HOSTED_SDIO_RESET_ACTIVE_HIGH=y
CONFIG_ESP_HOSTED_CUSTOM_SDIO_PINS=y
CONFIG_ESP_HOSTED_SDIO_PIN_CMD=13
CONFIG_ESP_HOSTED_SDIO_PIN_CLK=12
CONFIG_ESP_HOSTED_SDIO_PIN_D0=11
CONFIG_ESP_HOSTED_SDIO_PIN_D1=10
CONFIG_ESP_HOSTED_SDIO_PIN_D2=9
CONFIG_ESP_HOSTED_SDIO_PIN_D3=8
CONFIG_ESP_HOSTED_SDIO_GPIO_RESET_SLAVE=54
CONFIG_ESP_HOSTED_SDIO_TX_Q_SIZE=20
CONFIG_ESP_HOSTED_SDIO_RX_Q_SIZE=20
CONFIG_ESP_HOSTED_USE_MEMPOOL=y

CONFIG_ESP_WIFI_REMOTE_ENABLED=y
CONFIG_ESP_WIFI_REMOTE_LIBRARY_HOSTED=y

CONFIG_MBEDTLS_EXTERNAL_MEM_ALLOC=y

CONFIG_ETH_ENABLED=y
CONFIG_ETH_USE_ESP32_EMAC=y
CONFIG_ETH_PHY_INTERFACE_RMII=y
CONFIG_ETH_RMII_CLK_INPUT=y
CONFIG_ETH_RMII_CLK_IN_GPIO=50

CONFIG_LV_USE_CLIB_MALLOC=y
CONFIG_LV_USE_CLIB_STRING=y
CONFIG_LV_USE_CLIB_SPRINTF=y
CONFIG_LV_DEF_REFR_PERIOD=20
CONFIG_LV_OS_FREERTOS=y
CONFIG_LV_DRAW_SW_DRAW_UNIT_CNT=2
CONFIG_LV_FONT_MONTSERRAT_12=y
CONFIG_LV_FONT_MONTSERRAT_14=y
CONFIG_LV_FONT_MONTSERRAT_16=y
CONFIG_LV_USE_FONT_COMPRESSED=y
CONFIG_LV_USE_FLEX=y
CONFIG_LV_USE_SCROLLBAR=y
CONFIG_LV_USE_KEYBOARD=y
CONFIG_LV_USE_TEXTAREA=y
CONFIG_LV_USE_BUTTON=y
CONFIG_LV_USE_SLIDER=y

CONFIG_MQTT_PROTOCOL_311=y

CONFIG_LWIP_SNTP_MAX_SERVERS=2
CONFIG_LWIP_SNTP_UPDATE_DELAY=3600000

CONFIG_PARTITION_TABLE_CUSTOM=y
CONFIG_PARTITION_TABLE_CUSTOM_FILENAME="partitions.csv"
```

## firmware/esp32-s3/main/Kconfig.projbuild
```kconfig
menu "LuomiNest Configuration"

    config LN_WIFI_SSID
        string "WiFi SSID"
        default "Xiaomi_65DF"
        help
            Default WiFi network name (used when no NVS config saved).

    config LN_WIFI_PASSWORD
        string "WiFi Password"
        default "18033810300xyr"
        help
            Default WiFi network password (used when no NVS config saved).

    config LN_MQTT_BROKER
        string "MQTT Broker URI"
        default "mqtt://192.168.1.222:1883"
        help
            Default MQTT broker address (used when no NVS config saved).

    config LN_MQTT_CLIENT_ID
        string "MQTT Client ID"
        default "luominest_s3_01"
        help
            Default MQTT client identifier (used when no NVS config saved).

    config LN_AP_PASSWORD
        string "AP Mode Password"
        default "12345678"
        help
            Password for the configuration AP (min 8 chars for WPA2).

    config LN_FRAME_QUEUE_SIZE
        int "Frame queue size"
        default 2
        range 1 10
        help
            Number of JPEG frames to buffer before decoding.
            Larger values use more PSRAM but reduce frame drops.

    config LN_STATUS_INTERVAL_SEC
        int "Status report interval (seconds)"
        default 10
        range 5 120
        help
            How often to publish device online status via MQTT.

    config LN_ENABLE_WATCHDOG
        bool "Enable task watchdog"
        default y
        help
            Enable watchdog timer to detect and recover from hung tasks.

    config LN_WATCHDOG_TIMEOUT_SEC
        int "Watchdog timeout (seconds)"
        default 30
        range 5 120
        depends on LN_ENABLE_WATCHDOG
        help
            Timeout before watchdog triggers a system reset.

    config LN_MQTT_RECONNECT_MAX_MS
        int "MQTT max reconnect backoff (ms)"
        default 60000
        range 5000 300000
        help
            Maximum delay between MQTT reconnection attempts (ms).
            Uses exponential backoff starting from 1000ms.

    config LN_WIFI_RECONNECT_MAX_MS
        int "WiFi max reconnect backoff (ms)"
        default 30000
        range 5000 120000
        help
            Maximum delay between WiFi reconnection attempts (ms).
            Uses exponential backoff starting from 500ms.

    config LN_FRAME_DEDUP
        bool "Enable frame deduplication"
        default y
        help
            Skip decoding JPEG frames that are identical to the previous frame.
            Saves CPU and reduces visual flicker on static scenes.

endmenu
```

## firmware/esp32-s3/sdkconfig.defaults
```kconfig
CONFIG_IDF_TARGET="esp32s3"

CONFIG_ESPTOOLPY_FLASHMODE_QIO=y
CONFIG_ESPTOOLPY_FLASHSIZE_16MB=y

CONFIG_SPIRAM=y
CONFIG_SPIRAM_MODE_OCT=y
CONFIG_SPIRAM_SPEED_80M=y
CONFIG_SPIRAM_FETCH_INSTRUCTIONS=y
CONFIG_SPIRAM_RODATA_ACCESS=y

CONFIG_ESP_MAIN_TASK_STACK_SIZE=8192
CONFIG_FREERTOS_HZ=1000

CONFIG_LV_USE_CLIB_MALLOC=y
CONFIG_LV_USE_CLIB_STRING=y
CONFIG_LV_USE_CLIB_SPRINTF=y
CONFIG_LV_DEF_REFR_PERIOD=33
CONFIG_LV_OS_FREERTOS=y
CONFIG_LV_DRAW_SW_DRAW_UNIT_CNT=2
CONFIG_LV_FONT_MONTSERRAT_14=y
CONFIG_LV_FONT_MONTSERRAT_16=y
CONFIG_LV_USE_FONT_COMPRESSED=y

CONFIG_MQTT_PROTOCOL_311=y

CONFIG_PARTITION_TABLE_CUSTOM=y
CONFIG_PARTITION_TABLE_CUSTOM_FILENAME="partitions.csv"

CONFIG_LN_WIFI_PASSWORD="18033810300xyr"
```
