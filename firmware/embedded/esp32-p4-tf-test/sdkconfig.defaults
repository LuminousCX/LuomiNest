## firmware/embedded/esp32-p4-tf-test/sdkconfig.defaults
```kconfig
CONFIG_IDF_TARGET="esp32p4"

CONFIG_ESPTOOLPY_FLASHMODE_DIO=y
CONFIG_ESPTOOLPY_FLASHSIZE_16MB=y

CONFIG_ESP_MAIN_TASK_STACK_SIZE=8192

CONFIG_SPIRAM=y
CONFIG_SPIRAM_SPEED_200M=y
CONFIG_SPIRAM_FETCH_INSTRUCTIONS=y
CONFIG_SPIRAM_RODATA_ACCESS=y

CONFIG_FATFS_LONG_FILENAMES=y
CONFIG_FATFS_LFN_HEAP=y
CONFIG_FATFS_USE_FASTSEEK=y

CONFIG_LOG_DEFAULT_LEVEL_INFO=y
CONFIG_LOG_MAXIMUM_LEVEL_DEBUG=y
```
